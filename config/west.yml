## config/west.yml
```yaml
manifest:
  remotes:
    - name: zmkfirmware
      url-base: https://github.com/zmkfirmware
    - name: darknao
      url-base: https://github.com/darknao
      # Additional modules containing boards/shields/custom code can be listed here as well.
      # See:
      # - https://zmk.dev/docs/features/modules
      # - https://docs.zephyrproject.org/3.5.0/develop/west/manifest.html#projects
  projects:
    # Commented out external eyelash_corne repo - using local board files in config/boards/ instead
    # - name: eyelash_corne
    #   url: https://github.com/a741725193/zmk-new_corne
    #   revision: main
    - name: zmk
      remote: darknao
      revision: darknao/rgb-dts
      import: app/west.yml
  self:
    path: config
```
